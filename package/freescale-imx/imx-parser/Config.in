## package/freescale-imx/imx-parser/Config.in
```kconfig
config BR2_PACKAGE_IMX_PARSER
	bool "imx-parser"
	depends on BR2_arm # Only relevant for i.MX
	help
	  Binary parser libraries for the Freescale i.MX SoCs.

	  This library is provided by Freescale as-is and doesn't have
	  an upstream.
```

## package/freescale-imx/xserver-xorg-video-imx-viv/Config.in
```kconfig
config BR2_PACKAGE_XSERVER_XORG_VIDEO_IMX_VIV
	bool "xserver-xorg-video-imx-viv"
	select BR2_PACKAGE_XPROTO_FONTSPROTO
	select BR2_PACKAGE_XPROTO_RANDRPROTO
	select BR2_PACKAGE_XPROTO_RENDERPROTO
	select BR2_PACKAGE_XPROTO_VIDEOPROTO
	select BR2_PACKAGE_XPROTO_XPROTO
	help
	  video driver for vivante video driver device
```

## package/fs-freertos-sample/Config.in
```kconfig
config BR2_PACKAGE_FS_FREERTOS_SAMPLE
	bool "FS FreeRTOS sample for CM4 on i.MX7ULP"
	default n
	help
	  Add FS FreeRTOS Sample files to add it for sdcard image on F&S
	  boards and modules.
```

## package/fs-update-solution/Config.in
```kconfig
config BR2_PACKAGE_FS_UPDATE_SOLUTION
        bool "F&S Updater"
		select BR2_PACKAGE_SQUASHFS
		select BR2_PACKAGE_SQUASHFS_GZIP
		select BR2_PACKAGE_UBOOT_TOOLS
		select BR2_PACKAGE_UBOOT_TOOLS_FWPRINTENV
		select BR2_PACKAGE_PYTHON3
		select BR2_PACKAGE_PYTHON3_SSL
		select BR2_PACKAGE_PYTHON3_UNICODEDATA
		select BR2_PACKAGE_PYTHON3_PYEXPAT
		select BR2_PACKAGE_PYTHON3_ZLIB
		select BR2_PACKAGE_PYTHON_AZURE_IOT_DEVICE
		select BR2_PACKAGE_PYTHON_CERTIFI
		select BR2_PACKAGE_PYTHON_CHARDET
		select BR2_PACKAGE_PYTHON_IDNA
		select BR2_PACKAGE_PYTHON_JANUS
		select BR2_PACKAGE_PYTHON_NUMPY_ARCH_SUPPORTS
		select BR2_PACKAGE_PYTHON_PAHO_MQTT
		select BR2_PACKAGE_PYTHON_PYSOCKS
		select BR2_PACKAGE_PYTHON_REQUESTS
		select BR2_PACKAGE_PYTHON_REQUESTS_UNIXSOCKET
		select BR2_PACKAGE_PYTHON_SETUPTOOLS
		select BR2_PACKAGE_PYTHON_SIX
		select BR2_PACKAGE_PYTHON_URLLIB3
		select BR2_PACKAGE_CA_CERTIFICATES
		select BR2_PACKAGE_JSON_GLIB
		select BR2_PACKAGE_BLUEZ5_UTILS_HEADERS
		select BR2_PACKAGE_LIBEVENT
		select BR2_PACKAGE_NTP
		select BR2_PACKAGE_NTP_SNTP
		select BR2_PACKAGE_NTP_NTPD
		select BR2_PACKAGE_RAUC
		select BR2_PACKAGE_RAUC_JSON
		select BR2_TARGET_ROOTFS_SQUASHFS
		select BR2_TARGET_ROOTFS_SQUASHFS4_ZSTD
		select BR2_PACKAGE_HOST_GENEXT2FS
		select BR2_PACKAGE_HOST_RAUC
		select BR2_PACKAGE_HOST_SQUASHFS
		select BR2_PACKAGE_PYTHON_FS_UPDATER_CLI

        help
          This is the F&S Updater - a developed solution
		  special for F&S-Boards

if BR2_PACKAGE_FS_UPDATE_SOLUTION

	choice
		prompt "NAND or eMMC version board"

	config BR2_PACKAGE_FS_UPDATE_SOLUTION_NAND
		bool "storage is NAND memory"
		select BR2_PACKAGE_MTD
		select BR2_PACKAGE_MTD_FLASHCP
		select BR2_PACKAGE_MTD_FLASH_ERASE
		select BR2_PACKAGE_MTD_FLASH_LOCK
		select BR2_PACKAGE_MTD_FLASH_UNLOCK
		select BR2_PACKAGE_MTD_MTD_DEBUG
		select BR2_PACKAGE_MTD_NANDWRITE
		select BR2_PACKAGE_MTD_NANDDUMP
		select BR2_PACKAGE_MTD_NANDTEST
		select BR2_PACKAGE_MTD_MTDINFO
		select BR2_PACKAGE_MTD_UBIATTACH
		select BR2_PACKAGE_MTD_UBICRC32
		select BR2_PACKAGE_MTD_UBIDETACH
		select BR2_PACKAGE_MTD_UBIMKVOL
		select BR2_PACKAGE_MTD_UBIFORMAT
		select BR2_PACKAGE_MTD_UBINFO
		select BR2_PACKAGE_MTD_UBINIZE
		select BR2_PACKAGE_MTD_UBIRENAME
		select BR2_PACKAGE_MTD_UBIRMVOL
		select BR2_PACKAGE_MTD_UBIRSVOL
		select BR2_PACKAGE_MTD_UBIUPDATEVOL
		select BR2_PACKAGE_MTD_UBIBLOCK

	config BR2_PACKAGE_FS_UPDATE_SOLUTION_MMC
		bool "storage is eMMC memory"

	endchoice

endif
```

## package/gettext-tiny/Config.in
```kconfig
config BR2_PACKAGE_GETTEXT_TINY
	bool
	select BR2_PACKAGE_HAS_GETTEXT
	help
	  Stub and/or lightweight replacements of the gnu gettext
	  suite; because the GNU one takes ages to compile.

	  https://github.com/sabotage-linux/gettext-tiny

if BR2_PACKAGE_GETTEXT_TINY

config BR2_PACKAGE_PROVIDES_GETTEXT
	default "gettext-tiny"

endif
```

## package/imx-gstreamer1/Config.in
```kconfig
# IMX version of Gstreamer 1.x & Plugins
source "package/imx-gstreamer1/imx-gstreamer1/Config.in"

if BR2_PACKAGE_IMX_GSTREAMER1
source "package/imx-gstreamer1/imx-gst1-plugins-base/Config.in"
source "package/imx-gstreamer1/imx-gst1-plugins-good/Config.in"
source "package/imx-gstreamer1/imx-gst1-plugins-bad/Config.in"
source "package/imx-gstreamer1/imx-gst1-plugins-ugly/Config.in"
source "package/imx-gstreamer1/imx-gst1-plugin/Config.in"
endif
```

## package/imx-gstreamer1/imx-gst1-plugin/Config.in
```kconfig
comment "imx-gst1-plugin needs an imx-specific Linux kernel to be built"
	depends on BR2_arm && !BR2_LINUX_KERNEL

comment "imx-gst1-plugin needs an (e)glibc toolchain"
	depends on BR2_arm
	depends on !BR2_TOOLCHAIN_USES_GLIBC

comment "imx-gst1-plugin depends on BR2_PACKAGE_FREESCALE_IMX"
	depends on !BR2_PACKAGE_FREESCALE_IMX

config BR2_PACKAGE_IMX_GST1_PLUGIN
	bool "imx-gst1-plugin (needed for hardware acceleration)"
	depends on BR2_LINUX_KERNEL
	depends on BR2_arm # Only relevant for i.MX
	depends on BR2_TOOLCHAIN_USES_GLIBC # imx-codec
	depends on BR2_PACKAGE_FREESCALE_IMX
	select BR2_PACKAGE_IMX_GST1_PLUGINS_BASE
	select BR2_PACKAGE_IMX_GST1_PLUGINS_BAD
	select BR2_PACKAGE_IMX_VPUWRAP
	select BR2_PACKAGE_IMX_LIB
	select BR2_PACKAGE_IMX_VPU
	select BR2_PACKAGE_IMX_PARSER
	select BR2_PACKAGE_IMX_CODEC
	select BR2_PACKAGE_LIBDRM
	help
	  GStreamer-1.0 plugins for hardware-accelerated audio and video
	  parsers and codecs on i.MX platforms. It requires a kernel that
	  includes the i.MX specific headers to be built.

	  To use the VPU, its firmware blob must be installed as well. This
	  can be found in the firmware-imx package in the "Hardware handling"
	  menu.

	  This library is provided by Freescale as-is and does not have
	  an upstream.

if BR2_PACKAGE_IMX_GST1_PLUGIN
choice
	prompt "i.MX platform"
	default BR2_PACKAGE_IMX_GST1_PLUGIN_PLATFORM_MX6  if BR2_PACKAGE_FREESCALE_IMX_PLATFORM_IMX6Q
	default BR2_PACKAGE_IMX_GST1_PLUGIN_PLATFORM_MX6SX  if BR2_PACKAGE_FREESCALE_IMX_PLATFORM_IMX6S
	default BR2_PACKAGE_IMX_GST1_PLUGIN_PLATFORM_MX6UL  if BR2_PACKAGE_FREESCALE_IMX_PLATFORM_IMX6UL
	default BR2_PACKAGE_IMX_GST1_PLUGIN_PLATFORM_MX7ULP  if BR2_PACKAGE_FREESCALE_IMX_PLATFORM_IMX7
	default BR2_PACKAGE_IMX_GST1_PLUGIN_PLATFORM_MX8  if BR2_PACKAGE_FREESCALE_IMX_PLATFORM_IMX8M


config BR2_PACKAGE_IMX_GST1_PLUGIN_PLATFORM_MX6
	bool "imx6"

config BR2_PACKAGE_IMX_GST1_PLUGIN_PLATFORM_MX66QP
	bool "imx6qp"

config BR2_PACKAGE_IMX_GST1_PLUGIN_PLATFORM_MX6SL
	bool "imx6sl"

config BR2_PACKAGE_IMX_GST1_PLUGIN_PLATFORM_MX6SLL
	bool "imx6sll"

config BR2_PACKAGE_IMX_GST1_PLUGIN_PLATFORM_MX6SX
	bool "imx6sx"

config BR2_PACKAGE_IMX_GST1_PLUGIN_PLATFORM_MX6UL
	bool "imx6ul/ull"

config BR2_PACKAGE_IMX_GST1_PLUGIN_PLATFORM_MX7D
	bool "imx7d"

config BR2_PACKAGE_IMX_GST1_PLUGIN_PLATFORM_MX7ULP
	bool "imx7ulp"

config BR2_PACKAGE_IMX_GST1_PLUGIN_PLATFORM_MX8
	bool "imx8"

endchoice

config BR2_PACKAGE_IMX_GST1_PLUGIN_PLATFORM
	string
	default "MX6" if BR2_PACKAGE_IMX_GST1_PLUGIN_PLATFORM_MX6
	default "MX6QP" if BR2_PACKAGE_IMX_GST1_PLUGIN_PLATFORM_MX66QP
	default "MX6SL" if BR2_PACKAGE_IMX_GST1_PLUGIN_PLATFORM_MX6SL
	default "MX6SLL" if BR2_PACKAGE_IMX_GST1_PLUGIN_PLATFORM_MX6SLL
	default "MX6SX" if BR2_PACKAGE_IMX_GST1_PLUGIN_PLATFORM_MX6SX
	default "MX6UL" if BR2_PACKAGE_IMX_GST1_PLUGIN_PLATFORM_MX6UL
	default "MX7D" if BR2_PACKAGE_IMX_GST1_PLUGIN_PLATFORM_MX7D
	default "MX7ULP" if BR2_PACKAGE_IMX_GST1_PLUGIN_PLATFORM_MX7ULP
	default "MX8" if BR2_PACKAGE_IMX_GST1_PLUGIN_PLATFORM_MX8

endif
```

## package/mqx/Config.in
```kconfig
config BR2_PACKAGE_MQX
       bool "MQX and MCC Userspace"
       help
         Add userspace tools for the MQX realtime operating system and
	 Multi Core Communciation (MCC)

source "package/mqx/libmcc/Config.in"
```

## package/mqx/libmcc/Config.in
```kconfig
config BR2_PACKAGE_LIBMCC
	bool "libmcc"
	depends on BR2_PACKAGE_MQX
	help
	  Add Multi Core Communication (MCC) library
```

## package/mqx/mcc-pingpong/Config.in
```kconfig
config BR2_PACKAGE_MCC_PINGPONG
	bool "mcc_pingpong"
	depends on BR2_PACKAGE_MQX
	select BR2_PACKAGE_LIBMCC
	help
	  Include pingpong demo for MCC
```

## package/mqx/mqxboot/Config.in
```kconfig
config BR2_PACKAGE_MQXBOOT
	bool "mqxboot"
	depends on BR2_PACKAGE_MQX
	select BR2_PACKAGE_LIBMCC
	help
	  Allow starting of MQX and similar applications on Cortex-M4
```

## package/mxm-wifiex-fs/Config.in
```kconfig
comment "F&S board support for AW-CM276NF needs a Linux kernel to be built"
	depends on !BR2_LINUX_KERNEL

config BR2_PACKAGE_MXM_WIFIEX_FS
	bool "F&S board support for AW-CM276NF WLAN"
	depends on BR2_LINUX_KERNEL
	help
	  Add kernel modules to support NXP (ex-Marvell) WLAN devices on
	  F&S boards and modules, e.g. the Azurewave AW CM276NF.

if BR2_PACKAGE_MXM_WIFIEX_FS

config BR2_PACKAGE_MXM_WIFIEX_FS_MLANUTL
	bool "Install the mlanutl program"
	help
	  Say Y if you want to have the mlanutl program on the target device.
	  This tool helps to show an configure WLAN specific settings, e.g.
	  set test modes when certifying the device.

config BR2_PACKAGE_MXM_WIFIEX_FS_SD8801
	bool "Add support for SD8801 (SDIO)"
	help
	  Add support for 8801 via SDIO. Needs SDIO support in the kernel.

config BR2_PACKAGE_MXM_WIFIEX_FS_SD8978
	bool "Add support for SD8978 (SDIO)"
	help
	  Add support for 8978 via SDIO. Needs SDIO support in the kernel.

config BR2_PACKAGE_MXM_WIFIEX_FS_SD8997
	bool "Add support for SD8997 (SDIO)"
	default y
	select BR2_PACKAGE_LINUX_FIRMWARE_MWIFIEX_SDSD8997
	help
	  Add support for 8997 via SDIO. Needs SDIO support in the kernel.

config BR2_PACKAGE_MXM_WIFIEX_FS_PCIE8997
	bool "Add support for PCIE8997 (PCIE)"
	select BR2_PACKAGE_LINUX_FIRMWARE_MWIFIEX_PCIEUSB8997
	help
	  Add support for 8997 via PCIE. Needs PCIE support in the kernel.

config BR2_PACKAGE_MXM_WIFIEX_FS_SD9098
	bool "Add support for SD9098 (SDIO)"
	help
	  Add support for 9098 via SDIO. Needs SDIO support in the kernel.

config BR2_PACKAGE_MXM_WIFIEX_FS_PCIE9098
	bool "Add support for PCIE9098 (PCIE)"
	help
	  Add support for 9098 via PCIE. Needs PCIE support in the kernel.

endif
```

## package/ptp-gadget/Config.in
```kconfig
config BR2_PACKAGE_PTP_GADGET
	bool "ptp-gadget"
	select BR2_PACKAGE_LIBGLIB2
	depends on BR2_TOOLCHAIN_GLIBC_GCONV_LIBS_COPY
	depends on BR2_arm || BR2_i386 || BR2_x86_64
	help
	  ptp-gadget is a simple picture transfer protocol (PTP) device
	  implementation. PTP provides access from a USB host to a directory
	  of the device and allows the host to load files from and store
	  files to this directory (usually pictures, but basically any file
	  type is possible). Other than with a USB mass storage device, the
	  device itself can still have access to this directory while the
	  host is connected and local changes to the directory contents are
	  immediately visible from the host.

	  http://git.denx.de/ptp-gadget.git

config BR2_PACKAGE_PTP_GADGET_DIR
	string "Directory to export for ptp-gadget"
	default "/tmp/ptp"
	depends on BR2_PACKAGE_PTP_GADGET
	help
	  The path that is exported by the ptp-gadget to the outside.
```

## package/python-azure-iot-device/Config.in
```kconfig
config BR2_PACKAGE_PYTHON_AZURE_IOT_DEVICE
	bool "python-azure-iot-device"
	select BR2_PACKAGE_PYTHON_URLLIB3 # runtime
	select BR2_PACKAGE_PYTHON_SIX # runtime
	select BR2_PACKAGE_PYTHON_PAHO_MQTT # runtime
	select BR2_PACKAGE_PYTHON_REQUESTS # runtime
	select BR2_PACKAGE_PYTHON_REQUESTS_UNIXSOCKET # runtime
	select BR2_PACKAGE_PYTHON_JANUS # runtime
	select BR2_PACKAGE_PYTHON_PYSOCKS # runtime

	help
	  Microsoft Azure IoT Device Library.

	  https://github.com/Azure/azure-iot-sdk-python/tree/master/azure-iot-device
```

## package/python-erpc/Config.in
```kconfig
config BR2_PACKAGE_PYTHON_ERPC
	bool "python-erpc"
	select BR2_PACKAGE_HOST_PYTHON_SERIAL
	help
     eRPC (Embedded RPC) is an open source Remote Procedure Call (RPC) system
     for multichip embedded systems and heterogeneous multicore SoCs.

	 https://github.com/EmbeddedRPC/erpc
```

## package/python-fs-updater-cli/Config.in
```kconfig
config BR2_PACKAGE_PYTHON_FS_UPDATER_CLI
	bool "python-fs-updater-cli"

	select BR2_PACKAGE_PYTHON_FS_UPDATER_LIB # runtime

	help
	  The F&S Updater Client
```

## package/python-fs-updater-lib/Config.in
```kconfig
config BR2_PACKAGE_PYTHON_FS_UPDATER_LIB
	bool "python-fs-updater-lib"

	select BR2_PACKAGE_PYTHON_REQUESTS # runtime
	select BR2_PACKAGE_PYTHON_CRYPTOGRAPHY # runtime


	help
	  Libarary for the F&S Updater Client and Azure frontend.
```

## package/python-isodate/Config.in
```kconfig
config BR2_PACKAGE_PYTHON_ISODATE
	bool "python-isodate"
	select BR2_PACKAGE_PYTHON_SIX # runtime
	help
	  An ISO 8601 date/time/duration parser and formatter.

	  https://github.com/gweis/isodate/
```

## package/python-msrest/Config.in
```kconfig
config BR2_PACKAGE_PYTHON_MSREST
	bool "python-msrest"
	select BR2_PACKAGE_PYTHON_REQUESTS # runtime
	select BR2_PACKAGE_PYTHON_REQUESTS_OAUTHLIB # runtime
	select BR2_PACKAGE_PYTHON_ISODATE # runtime
	select BR2_PACKAGE_PYTHON_CERTIFI # runtime
	help
	  AutoRest swagger generator Python client runtime.

	  https://github.com/Azure/msrest-for-python
```

## package/python-requests-unixsocket/Config.in
```kconfig
config BR2_PACKAGE_PYTHON_REQUESTS_UNIXSOCKET
	bool "python-requests-unixsocket"
	select BR2_PACKAGE_PYTHON_PBR # for building	

	help
	  Use requests to talk HTTP via a UNIX domain socket

	  https://pypi.org/project/requests-unixsocket/
```

## package/python3-pycryptodomex/Config.in.host
```kconfig
config BR2_PACKAGE_HOST_PYTHON3_PYCRYPTODOMEX
	bool "host pycryptodomex"
	select BR2_PACKAGE_HOST_PYTHON3
	help
	  Cryptographic library for Python.

	  http://www.pycryptodome.org
```

## package/silex-wlan-fs/Config.in
```kconfig
comment "F&S board support for Silex WLAN needs a Linux kernel to be built"
	depends on !BR2_LINUX_KERNEL

config BR2_PACKAGE_SILEX_WLAN_FS
	bool "F&S board support for Silex WLAN"
	depends on BR2_LINUX_KERNEL
	help
	  Add kernel modules and firmware files to support the Silex WLAN
	  on F&S boards and modules. These files are closed-source and only
	  work for the appropriate kernel version.

comment "Remove regular wpa_supplicant to have Silex version here"
	depends on BR2_PACKAGE_SILEX_WLAN_FS
	depends on BR2_PACKAGE_WPA_SUPPLICANT

config BR2_PACKAGE_SILEX_WLAN_FS_WPA_SUPPLICANT
	bool "Add Silex specific wpa_supplicant/wpa_cli/wpa_passphrase"
	depends on BR2_PACKAGE_SILEX_WLAN_FS
	depends on !BR2_PACKAGE_WPA_SUPPLICANT
	default y
	help
	  The Silex WLAN driver is only certified for a different version of
	  wpa_supplicant. Add this version to the system.

comment "Remove regular hostapd to have Silex version here"
	depends on BR2_PACKAGE_SILEX_WLAN_FS
	depends on BR2_PACKAGE_HOSTAPD

config BR2_PACKAGE_SILEX_WLAN_FS_HOSTAPD
	bool "Add Silex specific hostapd/hostapd_cli"
	depends on BR2_PACKAGE_SILEX_WLAN_FS
	depends on !BR2_PACKAGE_HOSTAPD
	default y
	help
	  The Silex WLAN driver is only certified for a different version of
	  hostapd. Add this version to the system.
```

## package/silex-wlanbt-fs-firmware/Config.in
```kconfig
config BR2_PACKAGE_SILEX_WLANBT_FS_FIRMWARE
	bool "Firmware files for Silex WLAN/Bluetooth"
	depends on BR2_PACKAGE_SILEX_WLANBT_FS
	default y
	help
	  Add firmware files to support the Silex WLAN/Bluetooth on F&S
	  boards and modules.
```

## package/silex-wlanbt-fs/Config.in
```kconfig
comment "F&S board support for Silex WLAN/BT needs a Linux kernel to be built"
	depends on !BR2_LINUX_KERNEL

config BR2_PACKAGE_SILEX_WLANBT_FS
	bool "F&S board support for Silex WLAN/Bluetooth"
	depends on BR2_LINUX_KERNEL
	help
	  Add a kernel module to support the Silex WLAN on F&S boards and
	  modules. Please also enable BR2_PACKAGE_SILEX_WLANBT_FS_FIRMWARE
	  that contains the necessary firmware files.
```
